## config/boards/shields/vanana/Kconfig.defconfig
```kconfig
# Copyright (c) 2020 dELLIKEEb
# SPDX-License-Identifier: MIT

if SHIELD_VANANA

config ZMK_KEYBOARD_NAME
	default "Vanana"

endif
```

## config/boards/shields/vanana/Kconfig.shield
```kconfig
# Copyright (c) 2020 dELLIKEEb
# SPDX-License-Identifier: MIT

config SHIELD_VANANA
	def_bool $(shields_list_contains,vanana)
```
